/*
 * NRF24L01.c
 *
 * Created: 20-Jan-21 7:36:29 PM
 *  Author: ideapad510
 */ 
#include "NRF24L01.h"
/*#include "uart.h"*/
volatile unsigned char NRF_STATUS;
volatile NRF_DT NRF1;




unsigned char NRF_SPI_EXCHANGE(unsigned char TX_DATA)
{
	SPDR=TX_DATA;
	while(isbitclear(SPSR,7));
	return SPDR;
}

void NRF_WRITE_REGISTER(unsigned char REGISTER_NUM,unsigned char DATA)
{
	NRF_SPI_CLEAR_PIN();
	NRF_STATUS=NRF_SPI_EXCHANGE(WRITE_REGISTER_COMMAND(REGISTER_NUM));
	NRF_SPI_EXCHANGE(DATA);
	NRF_SPI_SET_PIN();  
	_delay_ms(1);
}

unsigned char NRF_READ_REGISTER(unsigned char REGISTER_NUM)
{
	unsigned char DATA;
	NRF_SPI_CLEAR_PIN();
	NRF_STATUS=NRF_SPI_EXCHANGE(READ_REGISTER_COMMAND(REGISTER_NUM));
	DATA=NRF_SPI_EXCHANGE(0xFF);
	NRF_SPI_SET_PIN();
	_delay_ms(1);
	return DATA;
}

void NRF_R_RX_PAYLOAD_DYNAMIC(unsigned char *DATA,unsigned char LENGTH)
{
	unsigned char i=0;
	
	NRF_SPI_CLEAR_PIN();
	NRF_STATUS=NRF_SPI_EXCHANGE(READ_RX_PAYLOAD_COMMAND);
	for (i=0;i<LENGTH;++i)
	{
		DATA[i]=NRF_SPI_EXCHANGE(0xff);
	}
	NRF_SPI_SET_PIN();
}

void NRF_W_TX_PAYLOAD_ACK(unsigned char *DATA,unsigned char LENGTH)
{
	unsigned char i=0;
	
	NRF_SPI_CLEAR_PIN();
	NRF_STATUS=NRF_SPI_EXCHANGE(WRITE_TX_PAYLOAD_COMMAND);
	for (i=0;i<LENGTH;++i)
	{
		NRF_SPI_EXCHANGE(DATA[i]);
	}
	NRF_SPI_SET_PIN();
}
void NRF_W_TX_PAYLOAD_NOACK(unsigned char *DATA,unsigned char LENGTH)
{
	unsigned char i=0;
	
	NRF_SPI_CLEAR_PIN();
	NRF_STATUS=NRF_SPI_EXCHANGE(WRITE_TX_PL_NO_ACK_COMMAND);
	for (i=0;i<LENGTH;++i)
	{
		NRF_SPI_EXCHANGE(DATA[i]);
	}
	NRF_SPI_SET_PIN();
}
void NRF_FLUSH_TX_BUFFER()
{
	NRF_SPI_CLEAR_PIN();
	NRF_STATUS=NRF_SPI_EXCHANGE(FLUSH_TX_COMMAND);
	NRF_SPI_SET_PIN();
}
void NRF_FLUSH_RX_BUFFER()
{
	NRF_SPI_CLEAR_PIN();
	NRF_STATUS=NRF_SPI_EXCHANGE(FLUSH_RX_COMMAND);
	NRF_SPI_SET_PIN();
}
void NRF_RETX_PL()
{
	NRF_SPI_CLEAR_PIN();
	NRF_STATUS=NRF_SPI_EXCHANGE(REUSE_TX_PL_COMMAND);
	NRF_SPI_SET_PIN();
}
unsigned char NRF_READ_LENGTH_RX_PL()
{
	unsigned char DATA;
	NRF_SPI_CLEAR_PIN();
	NRF_STATUS=NRF_SPI_EXCHANGE(READ_RX_PL_WIDTH_COMMAND);
	DATA=NRF_SPI_EXCHANGE(0xFF);
	NRF_SPI_SET_PIN();
	return DATA;
}

unsigned char NRF_READ_STATUS_NOW()
{
	NRF_SPI_CLEAR_PIN();
	NRF_STATUS=NRF_SPI_EXCHANGE(NRF24L01_NOP_COMMAND);
	NRF_SPI_SET_PIN();
	return NRF_STATUS;
}

unsigned char NRF_READ_RPD()
{
	return NRF_READ_REGISTER(NRF_RPD_ADDRESS);
}

unsigned char NRF_READ_RX_DR_AND_CLEAR()
{
	volatile unsigned char STATES_TEMP;
	STATES_TEMP=NRF_READ_REGISTER(NRF_STATUS_ADDRESS);
	if (STATES_TEMP&0b01000000)
	{
		NRF_WRITE_REGISTER(NRF_STATUS_ADDRESS,STATES_TEMP);
		return 1;
	}
	else
	{
		return 0;	
	}
}
unsigned char NRF_READ_TX_DS_AND_CLEAR()
{
	volatile unsigned char STATES_TEMP;
	STATES_TEMP=NRF_READ_REGISTER(NRF_STATUS_ADDRESS);
	if (STATES_TEMP&0b00100000)
	{
		NRF_WRITE_REGISTER(NRF_STATUS_ADDRESS,STATES_TEMP);
		return 1;
	}
	else
	{
		return 0;
	}
}
unsigned char NRF_READ_MAX_RT_AND_CLEAR()
{
	volatile unsigned char STATES_TEMP;
	STATES_TEMP=NRF_READ_REGISTER(NRF_STATUS_ADDRESS);
	if (STATES_TEMP&0b00010000)
	{
		NRF_WRITE_REGISTER(NRF_STATUS_ADDRESS,STATES_TEMP);
		return 1;
	}
	else
	{
		return 0;
	}
}

void NRF_SET_TX_MODE()
{
	volatile unsigned char TEMP;
	TEMP=NRF_READ_REGISTER(NRF_CONFIG_ADDRESS);
	clearbit(TEMP,NRF_PRIM_RX_BIT);
	NRF_WRITE_REGISTER(NRF_CONFIG_ADDRESS,TEMP);
}
void NRF_SET_RX_MODE()
{
	volatile unsigned char TEMP;
	TEMP=NRF_READ_REGISTER(NRF_CONFIG_ADDRESS);
	setbit(TEMP,NRF_PRIM_RX_BIT);
	NRF_WRITE_REGISTER(NRF_CONFIG_ADDRESS,TEMP);
}






void NRF_UPDATE_PIPE_RX_ADDRESS(unsigned char NUMBER,volatile unsigned char *ADDRESS,unsigned char LENGTH)
{
	unsigned char i=0;
	NRF_SPI_CLEAR_PIN();
	NRF_STATUS=NRF_SPI_EXCHANGE(WRITE_REGISTER_COMMAND((unsigned char)(NRF_RX_ADDR_P0_ADDRESS+NUMBER)));
	for(i=0;i<LENGTH;++i)
	{
		NRF_SPI_EXCHANGE(ADDRESS[i]);
	}
	NRF_SPI_SET_PIN();
}


void NRF_UPDATE_TX_ADDRESS(unsigned char *ADDRESS,unsigned char LENGTH)
{
	unsigned char i=0;
	NRF_SPI_CLEAR_PIN();
	NRF_STATUS=NRF_SPI_EXCHANGE(WRITE_REGISTER_COMMAND(NRF_TX_ADDR_TX_ADDRESS));
	for(i=0;i<LENGTH;++i)
	{
		NRF_SPI_EXCHANGE(ADDRESS[i]);
	}
	NRF_SPI_SET_PIN();
}

void NRF_UPDATE_USED_CHANNEL(NRF_RF_CHANNEL_DT channel)
{
	NRF1.NRF_RF_CH=channel;
	NRF_WRITE_REGISTER(NRF_RF_CH_ADDRESS,channel);
}

void NRF_UPDATE_RET_PL(NRF_RETRANSMIT_COUNT_DT RET)
{
	NRF1.NRF_SETUP_RETR&=0B11110000;
	NRF1.NRF_SETUP_RETR|=RET;	
	NRF_WRITE_REGISTER(NRF_SETUP_RETR_ADDRESS,NRF1.NRF_SETUP_RETR);
}
void NRF_IO_SETUP()
{
	gpio_outputconfg(PORT_DDR_CE,PORT_OUTMOD_CE,OUTPASS,CE_PIN);
	gpio_outputconfg(PORT_DDR_CSN,PORT_OUTMOD_CSN,OUTPASS,CSN_PIN);
	gpio_inputconfg(PORT_DDR_IRQ,PORT_INMOD_IRQ,PULLUP_mod,IRQ_PIN);
}
void NRF_SETUP_USED_CONFIG()
{
	
	
	NRF_SPI_SET_PIN();
	_delay_ms(100);
	NRF1.NRF_CONFIG=(NRF_USED_MASK_RX_DR<<NRF_MASK_RX_DR_BIT)|(NRF_USED_MASK_TX_DR<<NRF_MASK_TX_DS_BIT)|(NRF_USED_MASK_MAX_RT_DR<<NRF_MASK_MAX_RT_BIT)|(NRF_USED_CRC_STATE<<NRF_EN_CRC_BIT)|(NRF_USED_CRC<<NRF_CRCO_BIT)|(1<<NRF_PWR_UP_BIT);
	NRF_WRITE_REGISTER(NRF_CONFIG_ADDRESS,NRF1.NRF_CONFIG);
	_delay_ms(2);
	NRF1.NRF_ENABLE_AA=(NRF_USED_ENNAA_P0<<0)|(NRF_USED_ENNAA_P1<<1)|(NRF_USED_ENNAA_P2<<2)|(NRF_USED_ENNAA_P3<<3)|(NRF_USED_ENNAA_P4<<4)|(NRF_USED_ENNAA_P5<<5);
	NRF_WRITE_REGISTER(NRF_ENABLE_AA_ADDRESS,NRF1.NRF_ENABLE_AA);
	NRF1.NRF_ENABLE_RX_ADDRESS=(NRF_USED_ERX_P0<<0)|(NRF_USED_ERX_P1<<1)|(NRF_USED_ERX_P2<<2)|(NRF_USED_ERX_P3<<3)|(NRF_USED_ERX_P4<<4)|(NRF_USED_ERX_P5<<5);
	NRF_WRITE_REGISTER(NRF_ENABLE_RX_ADDRESS_ADDRESS,NRF1.NRF_ENABLE_RX_ADDRESS);
	NRF1.NRF_SETUP_AW=2;
	NRF1.NRF_SETUP_RETR=NRF_USED_WAIT_TIME|NRF_USED_RET_COUNT;
	NRF_WRITE_REGISTER(NRF_SETUP_RETR_ADDRESS,NRF1.NRF_SETUP_RETR);
	NRF1.NRF_RF_CH=NRF_USED_CH_1;
	NRF_WRITE_REGISTER(NRF_RF_CH_ADDRESS,NRF1.NRF_RF_CH);
	NRF1.NRF_RF_SETUP=NRF_USED_RF_SPEED|NRF_USED_POWER;
	NRF_WRITE_REGISTER(NRF_RF_SETUP_ADDRESS,NRF1.NRF_RF_SETUP);
	NRF1.NRF_RX_ADDR_P1[0]=NRF_USED_RX_ADDR_P1&0XFF;
	NRF1.NRF_RX_ADDR_P1[1]=(NRF_USED_RX_ADDR_P1>>8)&0XFF;
	NRF1.NRF_RX_ADDR_P1[2]=(NRF_USED_RX_ADDR_P1>>16)&0XFF;
	NRF1.NRF_RX_ADDR_P1[3]=(NRF_USED_RX_ADDR_P1>>24)&0XFF;
	NRF1.NRF_RX_ADDR_P1[4]=(NRF_USED_RX_ADDR_P1>>32)&0XFF;
	NRF_UPDATE_PIPE_RX_ADDRESS(1,NRF1.NRF_RX_ADDR_P1,5);
	NRF1.NRF_RX_PW_P1=32;
	NRF1.NRF_RX_PW_P0=32;
	NRF_WRITE_REGISTER(NRF_RX_PW_P1_ADDRESS,NRF1.NRF_RX_PW_P1);
	NRF_WRITE_REGISTER(NRF_RX_PW_P0_ADDRESS,NRF1.NRF_RX_PW_P0);
	NRF1.NRF_DYNPD=0b00000011;
	NRF_WRITE_REGISTER(NRF_DYNPD_ADDRESS,NRF1.NRF_DYNPD);
	NRF1.NRF_FEATURE=(NRF_USED_PL_WITH_ACK_STATE_AT_FIRST<<1)|(NRF_USED_EN_DPL<<2);
	NRF_WRITE_REGISTER(NRF_FEATURE_ADDRESS,NRF1.NRF_FEATURE);
	
	
	/*TEST_UART_SEND_str("state:");
	TEST_UART_SEND_VALUE(NRF_STATUS);*/
}

unsigned char NRF_SEND_DATA_WITH_ACK(unsigned char *ADDRESS,unsigned char ADDRESS_LENGTH,unsigned char *DATA,unsigned char DATA_LENGTH)
{
	NRF_CLEAR_CE();
	_delay_ms(1);
	NRF_WRITE_REGISTER(NRF_ENABLE_RX_ADDRESS_ADDRESS,0b00000011);
	NRF_WRITE_REGISTER(NRF_STATUS_ADDRESS,0b01110000);
	NRF_UPDATE_TX_ADDRESS(ADDRESS, ADDRESS_LENGTH);
	NRF_UPDATE_PIPE_RX_ADDRESS(0,ADDRESS,ADDRESS_LENGTH);
	NRF_FLUSH_TX_BUFFER();
	NRF_SET_TX_MODE();
	NRF_W_TX_PAYLOAD_ACK(DATA,DATA_LENGTH);
	NRF_SET_CE();
	_delay_ms(2);
	while (NRF_IS_IRQ_SET());
	NRF_CLEAR_CE();
	NRF_WRITE_REGISTER(NRF_ENABLE_RX_ADDRESS_ADDRESS,0b00000010);
	if (NRF_READ_TX_DS_AND_CLEAR())
	{
		return 1;
	}
	if (NRF_READ_MAX_RT_AND_CLEAR())
	{
		/*TEST_UART_SEND_str("heree\n");*/
		return 0;
	}
	return 0;
}

void NRF_START_RX_MODE()
{
	NRF_CLEAR_CE();
	_delay_ms(1);
	NRF_WRITE_REGISTER(NRF_STATUS_ADDRESS,0b01110000);
	NRF_FLUSH_RX_BUFFER();
	NRF_SET_RX_MODE();
	NRF_SET_CE();
}

void NRF_STOP_RX_MODE()
{
		NRF_CLEAR_CE();
		_delay_ms(1);
		NRF_WRITE_REGISTER(NRF_STATUS_ADDRESS,0b01110000);
		NRF_FLUSH_RX_BUFFER();
}

unsigned char NRF_CHECK_RX_PL(unsigned char *DATA,unsigned char* LENGTH)
{
	if (NRF_IS_IRQ_CLEAR())
	{
		if (NRF_READ_RX_DR_AND_CLEAR())
		{
			NRF_CLEAR_CE();
			*LENGTH=NRF_READ_LENGTH_RX_PL();
			NRF_R_RX_PAYLOAD_DYNAMIC(DATA,*LENGTH);	
			return 1;
		}
		return 0;
	}
	else
	{
		return 0;
	}
}
