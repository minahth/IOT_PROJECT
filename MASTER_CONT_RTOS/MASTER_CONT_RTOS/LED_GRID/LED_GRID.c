/*
 * LED_GRID.c
 *
 * Created: 01-Apr-21 1:25:07 PM
 *  Author: Mina Medhat
 */ 
#include "LED_GRID.h"
/*volatile unsigned char LED_GRID_ARRAY[8]={0xff,0xff,0xff,0xff,0xff,0xff,0xff,0xff};*/
/*volatile unsigned char LED_GRID_ARRAY[8]={0};*/
/*volatile unsigned char LED_GRID_ARRAY[8]={0B00000000,0B11100111,0B00011000,0B01100110,0B01100110,0B00000000,0B00111100,0B00000000};*/
volatile unsigned char LED_GRID_ARRAY[8]={ 0B10011001,0B10011001,0B10011001,0B10011001,0B10111101,0B11100111,0B11000011,0B10000001};//M
/*volatile unsigned char LED_GRID_ARRAY[8]={ 0B01100110,0B00110110,0B00011110,0B00001110,0B00001110,0B00011110,0B00110110,0B01100110};*///K	
/*volatile unsigned char LED_GRID_ARRAY[8]={ 0B01100110,0B01100110,0B01100110,0B01111110,0B01111110,0B01100110,0B00100100,0B00011000};*///A	
/*volatile unsigned char LED_GRID_ARRAY[8]={ 0B01100110,0B01100110,0B01100110,0B01111110,0B01111110,0B01100110,0B01100110,0B01100110};*///H			
	
volatile unsigned char LED_GRID_COUNTER=0;
volatile unsigned char F_B_NEW_LED_GRID=0;


void LED_GRID_IO_SETUP()
{
	*PORT_DDR_LED_GRID=0XFF;
	*PORT_OUTMOD_LED_GRID=0X00;
	*PORT_OUT_LED_GRID=0X00;
	gpio_outputconfg(PORT_DDR_LED_GRID_CONTROL,PORT_OUTMOD_LED_GRID_CONTROL,OUTPASS,0);
	gpio_outputconfg(PORT_DDR_LED_GRID_CONTROL,PORT_OUTMOD_LED_GRID_CONTROL,OUTPASS,1);
	gpio_outputconfg(PORT_DDR_LED_GRID_CONTROL,PORT_OUTMOD_LED_GRID_CONTROL,OUTPASS,2);
	
}

void LED_GRID_SETUP()
{
	LED_GRID_LOAD();
}

void LED_GRID_LOAD()
{
	if (readeeprom(MY_EEPROM_LED_GRID_FIRST_USE)==LED_GRID_FIRST_USE_VALUE)
	{
		unsigned char i=0;
		for (i=0;i<LED_GRID_SIZE;i++)
		{
			LED_GRID_ARRAY[i]=readeeprom(MY_EEPROM_FIRST_LED_GRID+i);
		}
	}
	else
	{
		unsigned char i=0;
		/*set the sensor array to zeros*/
		for (i=0;i<LED_GRID_SIZE;++i)
		{
			writeeeprom(MY_EEPROM_FIRST_LED_GRID+i,LED_GRID_ARRAY[i]);
		}
		/*set the value of checkfirst use to its value*/
		writeeeprom(MY_EEPROM_LED_GRID_FIRST_USE,LED_GRID_FIRST_USE_VALUE);
	}
}

 void  LOOP_LED_GRID()
{
	if(F_B_NEW_LED_GRID)
	{
		F_B_NEW_LED_GRID=0;
		unsigned char i=0;
		for (i=0;i<LED_GRID_SIZE;++i)
		{
			writeeeprom(MY_EEPROM_FIRST_LED_GRID+i,LED_GRID_ARRAY[i]);
		}
	}
	
}

void LED_GRID_TIMER_INT()
{
	
	
	LED_GRID_COUNTER=(LED_GRID_COUNTER+1)%LED_GRID_SIZE;
	*PORT_OUT_LED_GRID=LED_GRID_ARRAY[LED_GRID_COUNTER];
	*PORT_OUT_LED_GRID_CONTROL=(((*PORT_OUT_LED_GRID_CONTROL)&0B11111000)|LED_GRID_COUNTER);

}
